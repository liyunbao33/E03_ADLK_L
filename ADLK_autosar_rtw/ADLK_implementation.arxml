AUTOSAR XML (schema 4-3-1)
package /Components
  swc implementation ADLK_imp: programming-language=C, sw-version=1.28.1, used-code-generator=Embedded Coder 7.8 (R2022a) 23-Nov-2021, vendor-id=0, behavior=ADLK
    code-descriptors:
      code Code
        artifact-descriptors:
          short-label=ADLK_c, category=SWSRC
          short-label=ADLK_h, category=SWHDR
          short-label=ADLK_private_h, category=SWHDR
          short-label=ADLK_types_h, category=SWHDR
          short-label=rtwtypes_h, category=SWHDR
    resource consumption RsrcCons_ADLK
